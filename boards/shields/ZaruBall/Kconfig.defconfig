## boards/shields/ZaruBall/Kconfig.defconfig
```kconfig
# ==========================================
# 右手（Right）の設定：こちらを「親機（Central）」にする
# ==========================================
if SHIELD_ZARUBALL_RIGHT

config ZMK_KEYBOARD_NAME
    default "ZaruBall"

# 右手を親機にする設定（最新のZMKの書き方）
config ZMK_SPLIT_BLE_ROLE_CENTRAL
    default y

# マウス機能をONにする
config ZMK_POINTING
    default y

# SPIではなくI2Cを使うように変更！
config I2C
    default y

endif


# ==========================================
# 左手（Left）の設定：こちらは「子機（Peripheral）」になる
# ==========================================
if SHIELD_ZARUBALL_LEFT

config ZMK_KEYBOARD_NAME
    default "ZaruBall"

endif


# ==========================================
# 左右共通の設定
# ==========================================
if SHIELD_ZARUBALL_LEFT || SHIELD_ZARUBALL_RIGHT

# 分割キーボードであることを宣言
config ZMK_SPLIT
    default y

endif
```

## config/west.yml
```yaml
manifest:
  remotes:
    - name: zmkfirmware
      url-base: https://github.com/zmkfirmware
    - name: badjeff
      url-base: https://github.com/badjeff
    - name: caksoylar
      url-base: https://github.com/caksoylar
  projects:
    - name: zmk
      remote: zmkfirmware
      revision: v0.3
      import: app/west.yml
      # --- ここを追加 ---
    - name: zmk-studio
      remote: zmkfirmware
      revision: main
    # ----------------
    - name: zmk-rgbled-widget
      remote: caksoylar
      revision: v0.3-branch
      # west.yml の中にある拡張モジュール読み込みの例
    # ----------------
  - name: zmk-input-behavior-listener
    remote: badjeff
    revision: main
  self:
    path: config
```
